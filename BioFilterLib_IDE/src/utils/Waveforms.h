/**
 * @file Waveforms.h
 * @brief Señales de prueba para BioFilterLib
 * @author Sergio
 * @version 2.0.0
 * @date 2025
 *
 */

#ifndef WAVEFORMS_H
#define WAVEFORMS_H

#include <Arduino.h>
#include <stdint.h>
#include <string.h>
#include <arm_math.h>


// Tamaño de las señales
const uint16_t maxSamplesNum = 3000;

// Tabla de señales de prueba (valores 12-bit: 0-4095)
// [0] = Señal ECG limpia
// [1] = Señal ECG con ruido de 60Hz

// // Enum para identificar las señales de forma clara
// enum SignalType {
//     ECG_CLEAN,
//     ECG_60HZ_NOISED,
//     ECG_WHITE_NOISED,
//     UNKNOWN_SIGNAL
// };

// // Estructura para mapear etiquetas de texto a nuestros tipos de señal
// struct SignalMap {
//     const char* tag;
//     SignalType type;
//     const char* name;
// };

// // Tabla de búsqueda para las señales
// static const SignalMap signalTable[] = {
//     {"ecg_clean",        ECG_CLEAN,         "Clean ECG"},
//     {"0",                ECG_CLEAN,         "Clean ECG"},
//     {"ecg_60hz_noised",  ECG_60HZ_NOISED,   "ECG with 60Hz noise"},
//     {"1",                ECG_60HZ_NOISED,   "ECG with 60Hz noise"},
//     {"ecg_white_noised", ECG_WHITE_NOISED,  "ECG with white noise"},
//     {"2",                ECG_WHITE_NOISED,  "ECG with white noise"}
// };

// ====================
// DATOS DE EJEMPLO
// ====================

static const uint16_t waveformsTable[2][maxSamplesNum] = {

    // ECG limpio, fs = 960Hz, duracion = 2.896s, numSamples = 2780
    {
        0x2CC, 0x2D0, 0x2D3, 0x2D7, 0x2DA, 0x2DE, 0x2E2, 0x2E6, 0x2EA, 0x2EE,
        0x2F2, 0x2F6, 0x2FB, 0x2FF, 0x304, 0x309, 0x30E, 0x313, 0x318, 0x31D,
        0x323, 0x328, 0x32E, 0x334, 0x33A, 0x340, 0x346, 0x34D, 0x354, 0x35A,
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        0x27A, 0x278, 0x276, 0x274, 0x273, 0x271, 0x26F, 0x26E, 0x26D, 0x26B
    },

    // ECG con ruido de 60Hz añadido, fs = 960Hz, duracion = 2.896s, numSamples = 2780
    {
        0x33A, 0x3A3, 0x3FD, 0x43A, 0x452, 0x441, 0x40A, 0x3B7, 0x354, 0x2F1,
        0x29E, 0x268, 0x257, 0x270, 0x2AE, 0x309, 0x374, 0x3DF, 0x43A, 0x479,
        0x493, 0x483, 0x44E, 0x3FD, 0x39C, 0x33B, 0x2E9, 0x2B5, 0x2A7, 0x2C1,
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        0x3AE, 0x3E6, 0x3F9, 0x3E3, 0x3A7, 0x34F, 0x2E7, 0x27F, 0x227, 0x1EC
    },
  

};

// ====================
// FUNCIONES
// ====================

// /**
//  * @brief Obtiene el tipo de señal a partir de una etiqueta de texto.
//  *
//  * @param tag Etiqueta de la señal (ej. "ecg_clean").
//  * @return El tipo de señal correspondiente o UNKNOWN_SIGNAL si no se encuentra.
//  */
// inline SignalType getSignalType(const char* tag) {
//     if (!tag) return UNKNOWN_SIGNAL;

//     for (unsigned int i = 0; i < sizeof(signalTable) / sizeof(signalTable[0]); i++) {
//         if (strcasecmp(tag, signalTable[i].tag) == 0) {
//             return signalTable[i].type;
//         }
//     }
//     return UNKNOWN_SIGNAL;
// }

// /**
//  * @brief Carga una señal de prueba en un buffer y la normaliza.
//  *
//  * @param tag Etiqueta de la señal a cargar.
//  * @param buffer Puntero al buffer de flotantes donde se guardará la señal.
//  * @param numSamples Número de muestras a cargar.
//  * @return `true` si la señal se cargó correctamente, `false` en caso contrario.
//  */
// inline bool loadSignal(const char* tag, float32_t* buffer, uint16_t numSamples) {
//     SignalType signal = getSignalType(tag);

//     if (signal == UNKNOWN_SIGNAL) {
//         // Si la etiqueta no es válida, no hacer nada y devolver false
//         return false;
//     }

//     // Asegurarse de no leer más allá del tamaño del buffer
//     if (numSamples > maxSamplesNum) {
//         numSamples = maxSamplesNum;
//     }

//     // Copia y normaliza los datos de la señal seleccionada
//     for (uint16_t i = 0; i < numSamples; i++) {
//         uint16_t rawValue = waveformsTable[signal][i];
//         buffer[i] = ((float32_t)rawValue - 2048.0f) / 2048.0f;

//         // Pequeña pausa cada 100 muestras para estabilidad
//         if (i % 100 == 0 && i > 0) {
//             delay(1);
//         }
//     }

//     return true;
// }

// /**
//  * @brief Carga TODAS las muestras de una señal en un buffer y la normaliza.
//  *
//  * @param tag Etiqueta de la señal a cargar.
//  * @param buffer Puntero al buffer de flotantes donde se guardará la señal.
//  * @return `true` si la señal se cargó correctamente, `false` en caso contrario.
//  */
// inline bool loadSignal(const char* tag, float32_t* buffer) {
//     // Simplemente llama a la otra versión de la función, pidiendo todas las muestras.
//     return loadSignal(tag, buffer, maxSamplesNum);
// }




////////////////////////////////////////////////////////////////////////////////////////////////
////////////////////////////////////////////////////////////////////////////////////////////////
////////////////////////////////////////////////////////////////////////////////////////////////
////////////////////////////////////////////////////////////////////////////////////////////////

inline bool loadSignal(float32_t* buffer, const char* tag, uint16_t numSamples = 1500) {
    if (buffer == nullptr || tag == nullptr) {
        return false;
    }
    
    // Limitar al tamaño máximo disponible
    if (numSamples > maxSamplesNum) {
        numSamples = maxSamplesNum;
    }
    
    // Determinar índice - comparación simple sin strcasecmp
    int index = -1;
    
    // Comparar directamente (case sensitive para índices numéricos)
    if (strcmp(tag, "0") == 0) index = 0;
    else if (strcmp(tag, "1") == 0) index = 1;
    
    // Tags de texto (case insensitive manual)
    else {
        // Convertir primer caracter a lowercase para comparación
        char firstChar = tag[0];
        if (firstChar >= 'A' && firstChar <= 'Z') {
            firstChar = firstChar + 32;
        }
        
        // Comparación por primer caracter + longitud (rápido y seguro)
        if (firstChar == 'e' && strlen(tag) == 9) {
            // "ecg_clean"
            index = 0;
        } else if (firstChar == 'e' && strlen(tag) == 15 && tag[4] == '6') {
            // "ecg_60hz_noised"
            index = 1;
        }
    
        if (index < 0) {
            return false;
        }
        
        // Cargar señal - MÉTODO TESTEADO QUE FUNCIONA
        for (uint16_t i = 0; i < numSamples; i++) {
            uint16_t rawValue = waveformsTable[index][i];
            buffer[i] = ((float32_t)rawValue - 2048.0f) / 2048.0f;
            
            // Pequeña pausa cada 100 muestras para estabilidad
            if (i % 100 == 0 && i > 0) {
                delay(1);
            }
        }
        
        return true;
    }
}

/**
 * @brief Obtiene el nombre descriptivo de una señal
 * 
 * @param tag Etiqueta de la señal
 * @return Nombre descriptivo
 */

struct SignalMap {
    const char* tag;
    const char* name;
};

// Tabla de señales
static const SignalMap signalTable[] = {
    {"ecg_clean",             "Clean ECG"},
    {"0",                     "Clean ECG"},
    {"ecg_60hz_noised",       "ECG with 60Hz noise"},
    {"1",                     "ECG with 60Hz noise"},
};

////////////////////////////////////////////////////////////////////////////////////////////////
////////////////////////////////////////////////////////////////////////////////////////////////
////////////////////////////////////////////////////////////////////////////////////////////////
////////////////////////////////////////////////////////////////////////////////////////////////



/**
 * @brief Obtiene el nombre descriptivo de una señal.
 *
 * @param tag Etiqueta de la señal.
 * @return Nombre descriptivo
 */
inline const char* getSignalName(const char* tag) {
    if (!tag) return "Desconocida";

    for (unsigned int i = 0; i < sizeof(signalTable) / sizeof(signalTable[0]); i++) {
        if (strcasecmp(tag, signalTable[i].tag) == 0) {
            return signalTable[i].name;
        }
    }
    
    return "Desconocida";
}

/**
 * @brief Muestra lista de señales disponibles
 */
inline void printSignals() {
    Serial.println("Señales disponibles:");
    Serial.println("  'ecg_clean'  - Clean ECG");
    Serial.println("  'ecg_60hz_noised' - ECG with 60Hz noise");
    Serial.println("  'ecg_white_noised' - ECG with white noise");
}

#endif // WAVEFORMS_H